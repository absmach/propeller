## CMakeLists.txt
```
cmake_minimum_required(VERSION 3.20.0)

set(BOARD esp32s3_devkitc)

find_package(Zephyr REQUIRED HINTS $ENV{ZEPHYR_BASE})
project(proplet_mqtt_client)

set(WAMR_BUILD_PLATFORM "zephyr")
set(WAMR_BUILD_TARGET "XTENSA")

if (NOT DEFINED WAMR_BUILD_INTERP)
  set(WAMR_BUILD_INTERP 1)
endif ()

if (NOT DEFINED WAMR_BUILD_AOT)
  set(WAMR_BUILD_AOT 1)
endif ()

if (NOT DEFINED WAMR_BUILD_LIBC_BUILTIN)
  set(WAMR_BUILD_LIBC_BUILTIN 1)
endif ()

# Disable libc wasi support by default. In the future, 
# it can be enabled if libc wasi file/socket/lock support is ready on Zephyr platform
if (NOT DEFINED WAMR_BUILD_LIBC_WASI)
  set(WAMR_BUILD_LIBC_WASI 0)
endif ()

set(WAMR_BUILD_GLOBAL_HEAP_POOL 1)
if (NOT DEFINED WAMR_BUILD_GLOBAL_HEAP_SIZE)
  set(WAMR_BUILD_GLOBAL_HEAP_SIZE 40960)
endif ()

set(WAMR_ROOT_DIR ${CMAKE_CURRENT_SOURCE_DIR}/modules/wamr/wasm-micro-runtime)
include(${WAMR_ROOT_DIR}/build-scripts/runtime_lib.cmake)

list(APPEND ZEPHYR_EXTRA_MODULES ${WAMR_ROOT_DIR}/product-mini/platforms/zephyr)

include_directories(${ZEPHYR_BASE}/include/zephyr)

target_include_directories(app PRIVATE
    ${WAMR_ROOT_DIR}/core/iwasm/include
)

# Embed WAMR as a Zephyr library
zephyr_library_named(wamr_lib)

zephyr_library_sources(${WAMR_RUNTIME_LIB_SOURCE})

zephyr_library_app_memory(wamr_partition)

target_sources(app PRIVATE src/cJSON.c src/main.c src/mqtt_client.c src/task_monitor.c src/wasm_handler.c src/wifi_manager.c)

target_link_libraries(app PRIVATE wamr_lib)
```

## prj.conf
```kconfig
# General Networking
CONFIG_WIFI=y
CONFIG_WIFI_NM=y
CONFIG_NET_MGMT=y
CONFIG_NETWORKING=y
CONFIG_NET_CONFIG_AUTO_INIT=n
CONFIG_NET_MGMT_EVENT=y
CONFIG_NET_MGMT_EVENT_INFO=y
CONFIG_NET_MGMT_EVENT_QUEUE_SIZE=10
CONFIG_NET_MGMT_EVENT_STACK_SIZE=4096
CONFIG_NET_MGMT_EVENT_QUEUE_TIMEOUT=5000

# Protocols
CONFIG_NET_DHCPV4=y
CONFIG_NET_DHCPV4_SERVER=y
CONFIG_NET_IPV4=y
# Uncomment to enable IPv6
# CONFIG_NET_IPV6=y
CONFIG_NET_TCP=y
CONFIG_NET_UDP=y

# Interface Configuration
CONFIG_NET_IF_MAX_IPV4_COUNT=2
# required only if NET_IPV6 is set
# CONFIG_NET_IF_MAX_IPV6_COUNT=2
CONFIG_NET_L2_ETHERNET=y
CONFIG_NET_L2_WIFI_MGMT=y
CONFIG_WIFI_NM_MAX_MANAGED_INTERFACES=2

# Buffer and Packet Management
CONFIG_NET_BUF_RX_COUNT=64
CONFIG_NET_BUF_TX_COUNT=64
CONFIG_NET_BUF_DATA_SIZE=256
CONFIG_NET_PKT_RX_COUNT=32
CONFIG_NET_PKT_TX_COUNT=32
CONFIG_NET_RX_STACK_SIZE=2048
CONFIG_NET_TX_STACK_SIZE=2048
CONFIG_NET_MAX_CONTEXTS=10

# MQTT Client
CONFIG_MQTT_LIB=y
# Enable Sockets (used by MQTT lib and HTTP client)
CONFIG_NET_SOCKETS=y
# HTTP Client support
CONFIG_HTTP_CLIENT=y
CONFIG_HTTP_CLIENT_BUFFER_SIZE=4096

# Uncomment to enable TLS support for socket MQTT Library.
# CONFIG_MQTT_LIB_TLS=y
CONFIG_MQTT_KEEPALIVE=30
CONFIG_MQTT_CLEAN_SESSION=n
CONFIG_MQTT_LIB_WEBSOCKET=n
# Uncomment to enable ALPN protocol for socket MQTT Library.
# CONFIG_MQTT_LIB_TLS_USE_ALPN=y

# JSON Parsing
# CONFIG_JSON_LIBRARY=y
# Note: Zephyr's JSON library has been replaced by cJSON for JSON parsing and encoding.
# Uncomment the line above only if reverting to the Zephyr JSON library is necessary.

# Logging
CONFIG_LOG=y
CONFIG_LOG_DEFAULT_LEVEL=3
CONFIG_LOG_BUFFER_SIZE=4096
CONFIG_LOG_MODE_DEFERRED=n
# Uncomment to enable debug logs for mqtt, networking stack, Wi-Fi operations, and DHCPv4 server component.
# CONFIG_MQTT_LOG_LEVEL_DBG=y
# CONFIG_NET_LOG=y
# CONFIG_WIFI_LOG_LEVEL_DBG=y
# CONFIG_NET_DHCPV4_SERVER_LOG_LEVEL_DBG=y

# Debugging and Early Boot
CONFIG_EARLY_CONSOLE=y
CONFIG_INIT_STACKS=y
CONFIG_STACK_SENTINEL=y

# Statistics and Diagnostics
CONFIG_NET_STATISTICS=y
CONFIG_NET_STATISTICS_PERIODIC_OUTPUT=n

# Thread Analyzer
# Uncomment to debug thread-related issues.
# CONFIG_THREAD_NAME=y
# CONFIG_THREAD_ANALYZER=y
# CONFIG_THREAD_ANALYZER_AUTO=y
# CONFIG_THREAD_ANALYZER_AUTO_INTERVAL=5
# CONFIG_THREAD_ANALYZER_LOG_LEVEL_DBG=y
# CONFIG_THREAD_ANALYZER_ISR_STACK_USAGE=y

# Miscellaneous
CONFIG_BASE64=y
CONFIG_MAIN_STACK_SIZE=8192
CONFIG_IDLE_STACK_SIZE=2048
CONFIG_LOG_PROCESS_THREAD_STACK_SIZE=4096
CONFIG_DYNAMIC_THREAD_STACK_SIZE=4096
CONFIG_SYSTEM_WORKQUEUE_STACK_SIZE=4096
CONFIG_NET_SOCKETS_SERVICE_STACK_SIZE=4096
CONFIG_HEAP_MEM_POOL_SIZE=65536

# Metrics support
CONFIG_SYS_HEAP_RUNTIME_STATS=y
CONFIG_THREAD_MONITOR=y
CONFIG_CPU_LOAD=y
```

## boards/esp32s3_devkitc_procpu.conf
```kconfig
# ESP32 Wi-Fi Configuration
CONFIG_WIFI_ESP32=y
CONFIG_ESP32_WIFI_STA_RECONNECT=y
CONFIG_ESP32_WIFI_STA_AUTO_DHCPV4=y
CONFIG_ESP32_WIFI_AP_STA_MODE=n
CONFIG_ESP32_WIFI_DEBUG_PRINT=y
CONFIG_ESP32_WIFI_STA_RECONNECT=y
```

## boards/esp32s3_devkitc_procpu.overlay
```dts
&wifi {
	status = "okay";
};
```

## src/main.c
```c
#include "mqtt_client.h"
#include "task_monitor.h"
#include "wifi_manager.h"
#include <zephyr/kernel.h>
#include <zephyr/logging/log.h>

LOG_MODULE_REGISTER(main);

#define WIFI_SSID "<YOUR_WIFI_SSID>"
#define WIFI_PSK "<YOUR_WIFI_PSK>"
#define PROPLET_ID "<YOUR_PROPLET_ID>"
#define DOMAIN_ID "<YOUR_DOMAIN_ID>"
#define CHANNEL_ID "<YOUR_CHANNEL_ID>"
#define PROPLET_NAMESPACE "embedded"

#ifndef PROPLET_LIVELINESS_INTERVAL_MS
#define PROPLET_LIVELINESS_INTERVAL_MS 10000
#endif

#ifndef PROPLET_METRICS_INTERVAL_MS
#define PROPLET_METRICS_INTERVAL_MS 30000
#endif

#ifndef PROPLET_TASK_METRICS_INTERVAL_MS
#define PROPLET_TASK_METRICS_INTERVAL_MS 10000
#endif

const char *domain_id = DOMAIN_ID;
const char *channel_id = CHANNEL_ID;

int main(void)
{
  LOG_INF("Starting Proplet...");

  wifi_manager_init();
  wifi_manager_connect(WIFI_SSID, WIFI_PSK);

  if (task_monitor_init() != 0) {
    LOG_WRN("Task monitor init failed, metrics may be unavailable");
  }

  if (mqtt_client_connect(domain_id, PROPLET_ID, channel_id) != 0) {
    LOG_ERR("MQTT connect failed");
    return -1;
  }

  if (subscribe(domain_id, channel_id) != 0) {
    LOG_ERR("MQTT subscribe failed");
    return -1;
  }

  if (publish_discovery(domain_id, PROPLET_ID, channel_id) != 0) {
    LOG_ERR("MQTT discovery publish failed");
    return -1;
  }

  for (int i = 0; i < 20; i++) {
    mqtt_client_process();
    k_sleep(K_MSEC(100));
  }

  int64_t next_alive = k_uptime_get() + PROPLET_LIVELINESS_INTERVAL_MS;
  int64_t next_metrics = k_uptime_get() + PROPLET_METRICS_INTERVAL_MS;
  int64_t next_task_metrics = k_uptime_get() + PROPLET_TASK_METRICS_INTERVAL_MS;

  while (1) {
    mqtt_client_process();

    int64_t now = k_uptime_get();

    if (now >= next_alive) {
      publish_alive_message(domain_id, channel_id);
      next_alive = now + PROPLET_LIVELINESS_INTERVAL_MS;
    }

    if (now >= next_metrics) {
      publish_metrics_message(domain_id, channel_id, PROPLET_ID, PROPLET_NAMESPACE);
      next_metrics = now + PROPLET_METRICS_INTERVAL_MS;
    }

    if (now >= next_task_metrics) {
      publish_active_task_metrics(domain_id, channel_id, PROPLET_ID);
      next_task_metrics = now + PROPLET_TASK_METRICS_INTERVAL_MS;
    }

    k_sleep(K_MSEC(200));
  }
}
```

## src/certs.h
```c
#ifndef CERTS_H
#define CERTS_H

/* * PASTE THE CONTENT OF docker/ssl/certs/ca.crt HERE 
 * Ensure it is formatted as a C string or byte array.
 * Example:
 */
static const unsigned char ca_certificate[] =
"-----BEGIN CERTIFICATE-----\n"
"MIIDszCCApugAwIBAgIUB3iTenbwgVHkNaqbg4IKu0YCUR4wDQYJKoZIhvcNAQEN\n"
"...\n"
"-----END CERTIFICATE-----\n";

#endif
```

## src/client.c
```c
/*
 * client.c
 */

#include "client.h"

/* If you need the Wi-Fi header, you can include it here, e.g.:
 * #include <zephyr/net/wifi.h>
 */

/* Logging: create a separate log module for this client. */
LOG_MODULE_REGISTER(my_proplet_client, LOG_LEVEL_DBG);

/* Broker settings */
#define MQTT_BROKER_HOSTNAME       "test.mosquitto.org"
#define MQTT_BROKER_PORT           1883
#define MQTT_CLIENT_ID             "esp32s3_proplet"
#define MQTT_TOPIC_WASM_BINARY     "my_proplet/wasm_binary"
#define MQTT_TOPIC_EXEC_RESULT     "my_proplet/execution_result"

/* Buffers for MQTT messages */
static uint8_t rx_buffer[2048];
static uint8_t tx_buffer[2048];

/* MQTT client object & broker storage */
static struct mqtt_client client;
static struct sockaddr_storage broker_storage;

/* WAMR config */
#define WASM_MAX_APP_MEMORY      (64 * 1024)
#define WASM_STACK_SIZE          (8 * 1024)
#define WASM_HEAP_SIZE           (8 * 1024)

/* Forward declarations of any static (internal) functions */
static void mqtt_evt_handler(struct mqtt_client *const c,
                             const struct mqtt_evt *evt);

static int mqtt_subscribe_to_topic(void);
static int publish_execution_result(const char *result_str);
static int execute_wasm_buffer(const uint8_t *wasm_buf, size_t wasm_size);

/* -------------------------------------------------------------------------
 * 1. Prepare the broker
 * ------------------------------------------------------------------------- */
int prepare_broker(void)
{
    struct sockaddr_in *broker4 = (struct sockaddr_in *)&broker_storage;

    broker4->sin_family = AF_INET;
    broker4->sin_port = htons(MQTT_BROKER_PORT);

    if (net_addr_pton(AF_INET, MQTT_BROKER_HOSTNAME, &broker4->sin_addr)) {
        LOG_ERR("Failed to parse broker hostname/IP: %s", MQTT_BROKER_HOSTNAME);
        return -EINVAL;
    }

    return 0;
}

/* -------------------------------------------------------------------------
 * 2. Initialize the MQTT client structure
 * ------------------------------------------------------------------------- */
void init_mqtt_client(void)
{
    mqtt_client_init(&client);

    client.broker = &broker_storage;
    client.evt_cb = mqtt_evt_handler;

    client.client_id.utf8 = (uint8_t *)MQTT_CLIENT_ID;
    client.client_id.size = strlen(MQTT_CLIENT_ID);

    /* MQTT version 3.1.1 */
    client.protocol_version = MQTT_VERSION_3_1_1;

    /* Assign buffers */
    client.rx_buf = rx_buffer;
    client.rx_buf_size = sizeof(rx_buffer);
    client.tx_buf = tx_buffer;
    client.tx_buf_size = sizeof(tx_buffer);

    /* Clean session */
    client.clean_session = 1;

    /* Non-secure transport in this example (port 1883) */
    client.transport.type = MQTT_TRANSPORT_NON_SECURE;
}

/* -------------------------------------------------------------------------
 * 3. Connect to the broker
 * ------------------------------------------------------------------------- */
int mqtt_connect_to_broker(void)
{
    int ret = mqtt_connect(&client);
    if (ret) {
        LOG_ERR("mqtt_connect failed: %d", ret);
        return ret;
    }
    LOG_INF("MQTT client connected");
    return 0;
}

/* -------------------------------------------------------------------------
 * 4. The main MQTT processing loop
 *    Typically called from your main() in a while(1) or timed loop.
 * ------------------------------------------------------------------------- */
void mqtt_process_events(void)
{
    /* Let the MQTT client handle input and keepalive pings. */
    mqtt_input(&client);
    mqtt_live(&client);
}

/* -------------------------------------------------------------------------
 * Subscribe to the WASM binary topic
 * ------------------------------------------------------------------------- */
static int mqtt_subscribe_to_topic(void)
{
    struct mqtt_topic subscribe_topic = {
        .topic = {
            .utf8 = (uint8_t *)MQTT_TOPIC_WASM_BINARY,
            .size = strlen(MQTT_TOPIC_WASM_BINARY)
        },
        .qos = MQTT_QOS_1_AT_LEAST_ONCE
    };

    struct mqtt_subscription_list subscription_list = {
        .list = &subscribe_topic,
        .list_count = 1,
        .message_id = 1234
    };

    int ret = mqtt_subscribe(&client, &subscription_list);
    if (ret) {
        LOG_ERR("Failed to subscribe, err %d", ret);
        return ret;
    }

    LOG_INF("Subscribed to topic: %s", MQTT_TOPIC_WASM_BINARY);
    return 0;
}

/* -------------------------------------------------------------------------
 * Publish the execution result back
 * ------------------------------------------------------------------------- */
static int publish_execution_result(const char *result_str)
{
    struct mqtt_publish_param param;
    struct mqtt_topic topic = {
        .topic = {
            .utf8 = (uint8_t *)MQTT_TOPIC_EXEC_RESULT,
            .size = strlen(MQTT_TOPIC_EXEC_RESULT),
        },
        .qos = MQTT_QOS_1_AT_LEAST_ONCE
    };

    param.message.topic = topic;
    param.message.payload.data = (uint8_t *)result_str;
    param.message.payload.len  = strlen(result_str);
    param.message_id = 5678;
    param.dup_flag = 0;
    param.retain_flag = 0;

    return mqtt_publish(&client, &param);
}

/* -------------------------------------------------------------------------
 * Execute the WASM buffer: load, instantiate, call "add" function, publish
 * ------------------------------------------------------------------------- */
static int execute_wasm_buffer(const uint8_t *wasm_buf, size_t wasm_size)
{
    static bool wamr_initialized = false;
    if (!wamr_initialized) {
        RuntimeInitArgs init_args;
        memset(&init_args, 0, sizeof(RuntimeInitArgs));
        init_args.mem_alloc_type = Alloc_With_Pool;

        /* Provide a global heap for WAMR. */
        static uint8_t global_heap_buf[WASM_MAX_APP_MEMORY];
        init_args.mem_alloc_pool.heap_buf = global_heap_buf;
        init_args.mem_alloc_pool.heap_size = sizeof(global_heap_buf);

        if (!wasm_runtime_full_init(&init_args)) {
            LOG_ERR("Failed to initialize WAMR runtime");
            return -1;
        }

        wamr_initialized = true;
    }

    /* Load the module */
    WASMModuleCommon *wasm_module = wasm_runtime_load((uint8_t*)wasm_buf,
                                                      (uint32_t)wasm_size,
                                                      NULL, 0);
    if (!wasm_module) {
        LOG_ERR("Failed to load WASM module");
        return -1;
    }

    /* Instantiate */
    WASMModuleInstanceCommon *wasm_module_inst =
        wasm_runtime_instantiate(wasm_module,
                                 WASM_STACK_SIZE,
                                 WASM_HEAP_SIZE,
                                 NULL, 0);
    if (!wasm_module_inst) {
        LOG_ERR("Failed to instantiate WASM module");
        wasm_runtime_unload(wasm_module);
        return -1;
    }

    /* Find "add" function */
    const char *func_name = "add";
    wasm_function_inst_t func =
        wasm_runtime_lookup_function(wasm_module_inst, func_name, NULL);
    if (!func) {
        LOG_ERR("Exported function '%s' not found in wasm", func_name);
        goto clean;
    }

    /* Prepare arguments: (i32, i32)->i32. We'll call add(3, 4). */
    uint32_t argv[2];
    argv[0] = 3;
    argv[1] = 4;

    /* Call the function */
    if (!wasm_runtime_call_wasm(wasm_module_inst, func, 2, argv)) {
        LOG_ERR("Failed to call '%s'", func_name);
        goto clean;
    }

    /* The result is now in argv[0] */
    int32_t result = (int32_t)argv[0];
    LOG_INF("WASM function '%s'(3,4) -> %d", func_name, result);

    /* Publish result */
    char result_str[64];
    snprintf(result_str, sizeof(result_str),
             "Result from '%s'(3,4): %d", func_name, result);
    publish_execution_result(result_str);

clean:
    wasm_runtime_deinstantiate(wasm_module_inst);
    wasm_runtime_unload(wasm_module);
    return 0;
}

/* -------------------------------------------------------------------------
 * MQTT event callback (handles connect ack, publish, etc.)
 * ------------------------------------------------------------------------- */
static void mqtt_evt_handler(struct mqtt_client *const c,
                             const struct mqtt_evt *evt)
{
    switch (evt->type) {
    case MQTT_EVT_CONNACK:
        LOG_INF("MQTT_EVT_CONNACK");
        mqtt_subscribe_to_topic();
        break;

    case MQTT_EVT_DISCONNECT:
        LOG_INF("MQTT_EVT_DISCONNECT");
        break;

    case MQTT_EVT_PUBLISH: {
        LOG_INF("MQTT_EVT_PUBLISH");

        const struct mqtt_publish_param *p = &evt->param.publish;

        /* Validate topic */
        LOG_INF("Topic: %.*s, payload len %d",
                p->message.topic.topic.size,
                (char *)p->message.topic.topic.utf8,
                p->message.payload.len);

        if (p->message.payload.len > sizeof(rx_buffer)) {
            LOG_ERR("Received payload is too large!");
            break;
        }

        /* Read the payload into rx_buffer */
        int ret = mqtt_read_publish_payload(c, rx_buffer, p->message.payload.len);
        if (ret < 0) {
            LOG_ERR("mqtt_read_publish_payload error: %d", ret);
            break;
        }

        /* Execute as WASM module */
        execute_wasm_buffer(rx_buffer, p->message.payload.len);

        /* Acknowledge QOS1 */
        struct mqtt_puback_param puback = {
            .message_id = p->message_id
        };
        mqtt_publish_qos1_ack(c, &puback);
        break;
    }

    case MQTT_EVT_PUBACK:
        LOG_INF("MQTT_EVT_PUBACK id=%u result=%d",
                evt->param.puback.message_id,
                evt->result);
        break;

    case MQTT_EVT_SUBACK:
        LOG_INF("MQTT_EVT_SUBACK");
        break;

    default:
        break;
    }
}
```

## src/client.h
```c
#ifndef CLIENT_H
#define CLIENT_H

#include <zephyr/kernel.h>
#include <zephyr/net/mqtt.h>
#include <zephyr/net/socket.h>
#include <zephyr/logging/log.h>
#include <string.h>
#include <stdlib.h>
#include <stdio.h>

#include "wasm_export.h"

#ifdef __cplusplus
extern "C" {
#endif

int prepare_broker(void);

void init_mqtt_client(void);

int mqtt_connect_to_broker(void);

void mqtt_process_events(void);

#ifdef __cplusplus
}
#endif

#endif
```

## src/crypto_utils.c
```c
/*
 * Copyright (c) Abstract Machines
 * SPDX-License-Identifier: Apache-2.0
 */

#include "crypto_utils.h"
#include <mbedtls/gcm.h>
#include <string.h>
#include <zephyr/logging/log.h>

LOG_MODULE_REGISTER(crypto_utils, CONFIG_LOG_DEFAULT_LEVEL);

#define NONCE_SIZE 12
#define TAG_SIZE 16
#define KEY_SIZE_BITS 256
#define KEY_SIZE_BYTES (KEY_SIZE_BITS / 8)

int decrypt_payload(const uint8_t *enc_data, size_t enc_len, const uint8_t *key,
                    uint8_t *dec_data, size_t *dec_len)
{
    int ret;
    mbedtls_gcm_context gcm;

    if (enc_data == NULL || key == NULL || dec_data == NULL || dec_len == NULL) {
        LOG_ERR("Invalid arguments provided to decrypt_payload");
        return -1;
    }

    if (enc_len < (NONCE_SIZE + TAG_SIZE)) {
        LOG_ERR("Payload too short: %zu bytes (minimum %d)", enc_len, NONCE_SIZE + TAG_SIZE);
        return -1;
    }

    size_t ciphertext_len = enc_len - NONCE_SIZE - TAG_SIZE;
    *dec_len = ciphertext_len;

    const uint8_t *nonce = enc_data;
    const uint8_t *ciphertext = enc_data + NONCE_SIZE;
    const uint8_t *tag = enc_data + NONCE_SIZE + ciphertext_len;

    LOG_DBG("Decrypting: Total=%zu, Ciphertext=%zu, Nonce=%d, Tag=%d", 
            enc_len, ciphertext_len, NONCE_SIZE, TAG_SIZE);

    mbedtls_gcm_init(&gcm);

    ret = mbedtls_gcm_setkey(&gcm, MBEDTLS_CIPHER_ID_AES, key, KEY_SIZE_BITS);
    if (ret != 0) {
        LOG_ERR("mbedtls_gcm_setkey failed: -0x%04X", -ret);
        mbedtls_gcm_free(&gcm);
        return ret;
    }

    ret = mbedtls_gcm_auth_decrypt(&gcm,
                                   ciphertext_len,
                                   nonce, NONCE_SIZE,
                                   NULL, 0,
                                   tag, TAG_SIZE,
                                   ciphertext,
                                   dec_data);

    mbedtls_gcm_free(&gcm);

    if (ret != 0) {
        LOG_ERR("Decryption failed: -0x%04X. This usually means the Key is wrong or the data is corrupted.", -ret);
        return ret;
    }

    LOG_INF("Successfully decrypted %zu bytes", ciphertext_len);
    return 0;
}
```

## src/crypto_utils.h
```c
/*
 * Copyright (c) Abstract Machines
 * SPDX-License-Identifier: Apache-2.0
 */

#ifndef CRYPTO_UTILS_H
#define CRYPTO_UTILS_H

#include <stddef.h>
#include <stdint.h>

#ifdef __cplusplus
extern "C" {
#endif

/**
 * @brief Decrypts an AES-256-GCM payload.
 *
 * The payload is expected to follow the standard Go crypto/cipher format:
 * [ Nonce (12 bytes) | Ciphertext (n bytes) | Tag (16 bytes) ]
 *
 * @param enc_data      Pointer to the full encrypted buffer.
 * @param enc_len       Total length of enc_data.
 * @param key           32-byte AES key (raw bytes).
 * @param dec_data      Output buffer for plaintext. Must be large enough (enc_len - 28).
 * @param dec_len       Pointer to store the actual size of decrypted data.
 * @return 0 on success, negative error code on failure.
 */
int decrypt_payload(const uint8_t *enc_data, size_t enc_len, const uint8_t *key,
                    uint8_t *dec_data, size_t *dec_len);

#ifdef __cplusplus
}
#endif

#endif /* CRYPTO_UTILS_H */
```

## src/mqtt_client.h
```c
#ifndef MQTT_CLIENT_H
#define MQTT_CLIENT_H

#include <stdbool.h>
#include <stddef.h>
#include <stdint.h>
#include <zephyr/net/mqtt.h>

#define PAYLOAD_BUFFER_SIZE 1024

#define MAX_ID_LEN 64
#define MAX_NAME_LEN 64
#define MAX_STATE_LEN 16
#define MAX_URL_LEN 256
#define MAX_TIMESTAMP_LEN 32
#define MAX_BASE64_LEN 1024
#define MAX_INPUTS 16
#define MAX_RESULTS 16

struct task {
  char id[MAX_ID_LEN];
  char name[MAX_NAME_LEN];
  char state[MAX_STATE_LEN];
  char image_url[MAX_URL_LEN];
  char mode[MAX_NAME_LEN];

  char file[MAX_BASE64_LEN];
  size_t file_len;

  uint64_t inputs[MAX_INPUTS];
  size_t inputs_count;
  uint64_t results[MAX_RESULTS];
  size_t results_count;

  char start_time[MAX_TIMESTAMP_LEN];
  char finish_time[MAX_TIMESTAMP_LEN];
  char created_at[MAX_TIMESTAMP_LEN];
  char updated_at[MAX_TIMESTAMP_LEN];

  bool is_fl_task;

  char fl_round_id_str[32];
  char fl_format[MAX_NAME_LEN];
  char fl_num_samples_str[32];

  char round_id[MAX_ID_LEN];
  char model_uri[MAX_URL_LEN];
  char hyperparams[512];
  bool is_fml_task;

  char proplet_id[MAX_ID_LEN];
  char model_data[4096];
  char dataset_data[4096];
  char coordinator_url[MAX_URL_LEN];
  char model_registry_url[MAX_URL_LEN];
  char data_store_url[MAX_URL_LEN];
  bool model_data_fetched;
  bool dataset_data_fetched;
};

extern struct task g_current_task;

extern bool mqtt_connected;

/**
 * @brief Initialize the MQTT client and establish a connection to the broker.
 *
 * Connects using proplet_id as MQTT client ID and username, client_key as
 * password.
 *
 * @param domain_id   Domain ID used for topic generation (e.g.,
 * m/<domain>/c/<channel>/...).
 * @param proplet_id  Proplet identity (Magistrala client_id) — used as MQTT
 * username.
 * @param client_key  Magistrala client secret — used as MQTT password.
 * @param channel_id  Channel ID used for topic generation.
 *
 * @return 0 on success, negative errno on failure.
 */
int mqtt_client_connect(const char *domain_id, const char *proplet_id,
                        const char *client_key, const char *channel_id);

/**
 * @brief Subscribe to the manager/control topics for a channel.
 *
 * @param domain_id  Domain ID used for topic generation.
 * @param channel_id Channel ID used for topic generation.
 *
 * @return 0 on success, negative errno on failure.
 */
int subscribe(const char *domain_id, const char *channel_id);

/**
 * @brief Publish a message to a specific MQTT topic.
 *
 * @param domain_id       Domain ID used for topic generation.
 * @param channel_id      Channel ID used for topic generation.
 * @param topic_template  Topic template string that accepts (domain_id,
 * channel_id).
 * @param payload         Null-terminated JSON payload string.
 *
 * @return 0 on success, negative errno on failure.
 */
int publish(const char *domain_id, const char *channel_id,
            const char *topic_template, const char *payload);

/**
 * @brief Publish a periodic "alive" message to notify the manager of
 * liveliness.
 *
 * Uses the proplet_id captured during mqtt_client_connect().
 *
 * @param domain_id  Domain ID used for topic generation.
 * @param channel_id Channel ID used for topic generation.
 */
void publish_alive_message(const char *domain_id, const char *channel_id);

/**
 * @brief Publish periodic CPU/memory metrics.
 *
 * Payload shape: { proplet_id, namespace, metrics: {...} }
 *
 * @param domain_id   Domain ID used for topic generation.
 * @param channel_id  Channel ID used for topic generation.
 * @param proplet_id  Proplet identity.
 * @param namespace   Namespace label (e.g. "embedded").
 */
void publish_metrics_message(const char *domain_id, const char *channel_id,
                             const char *proplet_id, const char *namespace);

/**
 * @brief Publish a request to fetch a file from the registry.
 *
 * @param domain_id  Domain ID used for topic generation.
 * @param channel_id Channel ID used for topic generation.
 * @param app_name   Registry app name / image reference to fetch.
 */
void publish_registry_request(const char *domain_id, const char *channel_id,
                              const char *app_name);

/**
 * @brief Publish a discovery message when the Proplet comes online.
 *
 * Auto-detected fields (ip, environment, os, hostname, cpu_arch,
 * total_memory_bytes, wasm_runtime) are resolved inside the function.
 *
 * @param domain_id   Domain ID used for topic generation.
 * @param proplet_id  Proplet identity.
 * @param channel_id  Channel ID used for topic generation.
 * @param description Human-readable description of this proplet (may be empty).
 * @param tags        Comma-separated tag list, e.g. "gateway,prod" (may be
 * empty).
 * @param location    Physical or logical location string (may be empty).
 * @param version     Firmware/software version string.
 *
 * @return 0 on success, negative errno on failure.
 */
int publish_discovery(const char *domain_id, const char *proplet_id,
                      const char *channel_id, const char *description,
                      const char *tags, const char *location,
                      const char *version);

/**
 * @brief Publish the results of a completed task.
 *
 * @param domain_id  Domain ID used for topic generation.
 * @param channel_id Channel ID used for topic generation.
 * @param task_id    Task identifier.
 * @param results    Result string (will be JSON-escaped by caller if needed).
 */
void publish_results(const char *domain_id, const char *channel_id,
                     const char *task_id, const char *results);

/**
 * @brief Publish the results of a completed task with optional error message.
 *
 * @param domain_id  Domain ID used for topic generation.
 * @param channel_id Channel ID used for topic generation.
 * @param task_id    Task identifier.
 * @param results    Result string (will be JSON-escaped by caller if needed).
 * @param error_msg  Optional error message (NULL if no error).
 */
void publish_results_with_error(const char *domain_id, const char *channel_id,
                                const char *task_id, const char *results,
                                const char *error_msg);

/** @brief Publish task-level metrics for a specific task.
 *
 * Publishes CPU, memory, and timing metrics for a running or recently
 * completed WASM task.
 *
 * @param domain_id   Domain ID used for topic generation.
 * @param channel_id  Channel ID used for topic generation.
 * @param task_id     Task identifier being monitored.
 * @param proplet_id  Proplet identity.
 */
void publish_task_metrics(const char *domain_id, const char *channel_id,
                          const char *task_id, const char *proplet_id);

/**
 * @brief Publish metrics for all active monitored tasks.
 *
 * Iterates through all currently monitored tasks and publishes their metrics.
 *
 * @param domain_id   Domain ID used for topic generation.
 * @param channel_id  Channel ID used for topic generation.
 * @param proplet_id  Proplet identity.
 */
void publish_active_task_metrics(const char *domain_id, const char *channel_id,
                                 const char *proplet_id);

/**
 * @brief Publish WASM execution metrics.
 *
 * Publishes aggregate WASM execution statistics (execution count, timing, errors).
 *
 * @param domain_id   Domain ID used for topic generation.
 * @param channel_id  Channel ID used for topic generation.
 * @param proplet_id  Proplet identity.
 */
void publish_wasm_metrics(const char *domain_id,
                          const char *channel_id,
                          const char *proplet_id);

/**
 * @brief Process incoming MQTT messages and maintain keepalive.
 */
void mqtt_client_process(void);

/**
 * @brief Handle the start command received via MQTT.
 *
 * @param payload JSON payload for the start command.
 */
void handle_start_command(const char *payload);

/**
 * @brief Handle the stop command received via MQTT.
 *
 * @param payload JSON payload for the stop command.
 */
void handle_stop_command(const char *payload);

/**
 * @brief Handle registry response that contains the base64-encoded WASM.
 *
 * @param payload JSON payload containing app_name + data (base64).
 *
 * @return 0 on success, negative errno on failure.
 */
int handle_registry_response(const char *payload);

#endif /* MQTT_CLIENT_H */
```

## src/task_monitor.c
```c
#include "task_monitor.h"

#include <errno.h>
#include <string.h>

#include <zephyr/kernel.h>
#include <zephyr/logging/log.h>

#if defined(CONFIG_CPU_LOAD)
#include <zephyr/debug/cpu_load.h>
#endif

#if defined(CONFIG_SYS_HEAP_RUNTIME_STATS)
#include <zephyr/sys/sys_heap.h>
extern struct sys_heap _system_heap;
#endif

LOG_MODULE_REGISTER(task_monitor);

typedef struct {
  bool in_use;
  char task_id[MAX_TASK_ID_LEN];
  int64_t start_time_ms;
  process_metrics_t current;
  double cpu_sum;
  double cpu_max;
  uint64_t memory_sum;
  uint64_t memory_max;
  int sample_count;
} monitored_task_t;

static monitored_task_t g_monitored_tasks[MAX_MONITORED_TASKS];
static bool g_initialized = false;
static K_MUTEX_DEFINE(g_task_monitor_mutex);

/* Global WASM execution metrics */
static wasm_metrics_t g_wasm_metrics = {0};
static K_MUTEX_DEFINE(g_wasm_metrics_mutex);

static int find_task_slot(const char *task_id);
static int find_free_slot(void);
static void collect_current_metrics(process_metrics_t *metrics,
                                    int64_t start_time_ms);

#if defined(CONFIG_THREAD_MONITOR)
static void thread_count_cb(const struct k_thread *thread, void *user_data)
{
  ARG_UNUSED(thread);
  int *count = (int *)user_data;
  (*count)++;
}

static int get_thread_count(void)
{
  int count = 0;
  k_thread_foreach_unlocked(thread_count_cb, &count);
  return count;
}
#endif

int task_monitor_init(void)
{
  if (g_initialized) {
    return 0;
  }

  memset(g_monitored_tasks, 0, sizeof(g_monitored_tasks));
  g_initialized = true;

  LOG_INF("Task monitor initialized (max tasks: %d)", MAX_MONITORED_TASKS);
  return 0;
}

int task_monitor_start(const char *task_id)
{
  if (!g_initialized) {
    LOG_ERR("Task monitor not initialized");
    return -EINVAL;
  }

  if (task_id == NULL || strlen(task_id) == 0) {
    LOG_ERR("Invalid task ID");
    return -EINVAL;
  }

  k_mutex_lock(&g_task_monitor_mutex, K_FOREVER);

  int existing = find_task_slot(task_id);
  int slot;
  if (existing >= 0) {
    LOG_WRN("Task %s already being monitored, clearing and restarting",
            task_id);
    slot = existing;
  } else {
    slot = find_free_slot();
    if (slot < 0) {
      LOG_ERR("No free monitoring slots (max %d)", MAX_MONITORED_TASKS);
      k_mutex_unlock(&g_task_monitor_mutex);
      return -ENOMEM;
    }
  }

  monitored_task_t *task = &g_monitored_tasks[slot];
  memset(task, 0, sizeof(*task));

  strncpy(task->task_id, task_id, MAX_TASK_ID_LEN - 1);
  task->task_id[MAX_TASK_ID_LEN - 1] = '\0';
  task->start_time_ms = k_uptime_get();

  collect_current_metrics(&task->current, task->start_time_ms);

  task->cpu_sum = task->current.cpu_percent;
  task->cpu_max = task->current.cpu_percent;
  task->memory_sum = task->current.memory_bytes;
  task->memory_max = task->current.memory_bytes;
  task->sample_count = 1;

  task->in_use = true;

  k_mutex_unlock(&g_task_monitor_mutex);

  LOG_INF("Started monitoring task: %s", task_id);
  return 0;
}

int task_monitor_sample(const char *task_id)
{
  if (!g_initialized) {
    return -EINVAL;
  }

  k_mutex_lock(&g_task_monitor_mutex, K_FOREVER);

  int slot = find_task_slot(task_id);
  if (slot < 0) {
    LOG_WRN("Task %s not found for sampling", task_id);
    k_mutex_unlock(&g_task_monitor_mutex);
    return -ENOENT;
  }

  monitored_task_t *task = &g_monitored_tasks[slot];

  collect_current_metrics(&task->current, task->start_time_ms);

  task->cpu_sum += task->current.cpu_percent;
  if (task->current.cpu_percent > task->cpu_max) {
    task->cpu_max = task->current.cpu_percent;
  }

  task->memory_sum += task->current.memory_bytes;
  if (task->current.memory_bytes > task->memory_max) {
    task->memory_max = task->current.memory_bytes;
  }

  task->sample_count++;

  k_mutex_unlock(&g_task_monitor_mutex);

  LOG_DBG("Sampled task %s: cpu=%.1f%%, mem=%u bytes, samples=%d", task_id,
          task->current.cpu_percent, task->current.memory_bytes,
          task->sample_count);

  return 0;
}

int task_monitor_stop(const char *task_id)
{
  if (!g_initialized) {
    return -EINVAL;
  }

  k_mutex_lock(&g_task_monitor_mutex, K_FOREVER);

  int slot = find_task_slot(task_id);
  if (slot < 0) {
    LOG_WRN("Task %s not found to stop", task_id);
    k_mutex_unlock(&g_task_monitor_mutex);
    return -ENOENT;
  }

  monitored_task_t *task = &g_monitored_tasks[slot];

  collect_current_metrics(&task->current, task->start_time_ms);
  task->cpu_sum += task->current.cpu_percent;
  task->memory_sum += task->current.memory_bytes;
  if (task->current.cpu_percent > task->cpu_max) {
    task->cpu_max = task->current.cpu_percent;
  }
  if (task->current.memory_bytes > task->memory_max) {
    task->memory_max = task->current.memory_bytes;
  }
  task->sample_count++;

  task->in_use = false;

  k_mutex_unlock(&g_task_monitor_mutex);

  LOG_INF("Stopped monitoring task: %s (samples: %d)", task_id,
          task->sample_count);
  return 0;
}

int task_monitor_get_metrics(const char *task_id, task_metrics_t *metrics)
{
  if (!g_initialized || metrics == NULL) {
    return -EINVAL;
  }

  k_mutex_lock(&g_task_monitor_mutex, K_FOREVER);

  int slot = find_task_slot(task_id);
  if (slot < 0) {
    k_mutex_unlock(&g_task_monitor_mutex);
    return -ENOENT;
  }

  monitored_task_t *task = &g_monitored_tasks[slot];

  memset(metrics, 0, sizeof(*metrics));
  strncpy(metrics->task_id, task->task_id, MAX_TASK_ID_LEN - 1);
  metrics->active = task->in_use;
  metrics->start_time_ms = task->start_time_ms;

  memcpy(&metrics->current, &task->current, sizeof(process_metrics_t));

  if (task->sample_count > 0) {
    metrics->aggregated.avg_cpu_usage = task->cpu_sum / task->sample_count;
    metrics->aggregated.max_cpu_usage = task->cpu_max;
    metrics->aggregated.avg_memory_usage = task->memory_sum / task->sample_count;
    metrics->aggregated.max_memory_usage = task->memory_max;
    metrics->aggregated.sample_count = task->sample_count;
  }

  k_mutex_unlock(&g_task_monitor_mutex);

  return 0;
}

bool task_monitor_is_active(const char *task_id)
{
  if (!g_initialized || task_id == NULL) {
    return false;
  }

  k_mutex_lock(&g_task_monitor_mutex, K_FOREVER);

  int slot = find_task_slot(task_id);

  k_mutex_unlock(&g_task_monitor_mutex);

  return (slot >= 0);
}

int task_monitor_get_active_task_id(char *task_id_out)
{
  if (!g_initialized || task_id_out == NULL) {
    return -EINVAL;
  }

  k_mutex_lock(&g_task_monitor_mutex, K_FOREVER);

  for (int i = 0; i < MAX_MONITORED_TASKS; i++) {
    if (g_monitored_tasks[i].in_use) {
      strncpy(task_id_out, g_monitored_tasks[i].task_id, MAX_TASK_ID_LEN - 1);
      task_id_out[MAX_TASK_ID_LEN - 1] = '\0';
      k_mutex_unlock(&g_task_monitor_mutex);
      return 0;
    }
  }

  k_mutex_unlock(&g_task_monitor_mutex);
  return -ENOENT;
}

int task_monitor_get_active_count(void)
{
  if (!g_initialized) {
    return 0;
  }

  k_mutex_lock(&g_task_monitor_mutex, K_FOREVER);

  int count = 0;
  for (int i = 0; i < MAX_MONITORED_TASKS; i++) {
    if (g_monitored_tasks[i].in_use) {
      count++;
    }
  }

  k_mutex_unlock(&g_task_monitor_mutex);

  return count;
}

int task_monitor_get_active_task_id_at(int index, char *task_id_out)
{
  if (!g_initialized || task_id_out == NULL || index < 0) {
    return -EINVAL;
  }

  k_mutex_lock(&g_task_monitor_mutex, K_FOREVER);

  int active_index = 0;
  for (int i = 0; i < MAX_MONITORED_TASKS; i++) {
    if (g_monitored_tasks[i].in_use) {
      if (active_index == index) {
        strncpy(task_id_out, g_monitored_tasks[i].task_id, MAX_TASK_ID_LEN - 1);
        task_id_out[MAX_TASK_ID_LEN - 1] = '\0';
        k_mutex_unlock(&g_task_monitor_mutex);
        return 0;
      }
      active_index++;
    }
  }

  k_mutex_unlock(&g_task_monitor_mutex);
  return -ENOENT;
}

static int find_task_slot(const char *task_id)
{
  for (int i = 0; i < MAX_MONITORED_TASKS; i++) {
    if (g_monitored_tasks[i].in_use &&
        strcmp(g_monitored_tasks[i].task_id, task_id) == 0) {
      return i;
    }
  }
  return -1;
}

static int find_free_slot(void)
{
  for (int i = 0; i < MAX_MONITORED_TASKS; i++) {
    if (!g_monitored_tasks[i].in_use) {
      return i;
    }
  }
  return -1;
}

static void collect_current_metrics(process_metrics_t *metrics,
                                    int64_t start_time_ms)
{
  memset(metrics, 0, sizeof(*metrics));

#if defined(CONFIG_CPU_LOAD)
  metrics->cpu_percent = (double)cpu_load_get(false) / 10.0;
#else
  metrics->cpu_percent = 0.0;
#endif

#if defined(CONFIG_SYS_HEAP_RUNTIME_STATS)
  struct sys_memory_stats stat;

  if (sys_heap_runtime_stats_get(&_system_heap, &stat) == 0) {
    metrics->memory_bytes = stat.allocated_bytes;
    uint32_t total = stat.allocated_bytes + stat.free_bytes;
    if (total > 0) {
      metrics->memory_percent = (double)stat.allocated_bytes * 100.0 / total;
    }
  }
#else
  metrics->memory_bytes = 0;
  metrics->memory_percent = 0.0;
#endif

  int64_t now_ms = k_uptime_get();
  metrics->uptime_seconds = (now_ms - start_time_ms) / 1000;

#if defined(CONFIG_THREAD_MONITOR)
  metrics->thread_count = get_thread_count();
#else
  metrics->thread_count = 1;
#endif
}

/* WASM execution metrics functions */

uint64_t task_monitor_wasm_start(void)
{
  return (uint64_t)k_uptime_ticks();
}

void task_monitor_wasm_end(uint64_t start_ticks)
{
  uint64_t end_ticks = (uint64_t)k_uptime_ticks();
  uint32_t elapsed_us = (uint32_t)k_ticks_to_us_floor64(end_ticks - start_ticks);

  k_mutex_lock(&g_wasm_metrics_mutex, K_FOREVER);

  g_wasm_metrics.execution_count++;
  g_wasm_metrics.total_execution_us += elapsed_us;
  g_wasm_metrics.last_execution_us = elapsed_us;

  if (elapsed_us > g_wasm_metrics.max_execution_us) {
    g_wasm_metrics.max_execution_us = elapsed_us;
  }

  k_mutex_unlock(&g_wasm_metrics_mutex);

  LOG_DBG("WASM execution completed in %u us (total: %u executions)",
          elapsed_us, g_wasm_metrics.execution_count);
}

void task_monitor_wasm_error(void)
{
  k_mutex_lock(&g_wasm_metrics_mutex, K_FOREVER);
  g_wasm_metrics.error_count++;
  k_mutex_unlock(&g_wasm_metrics_mutex);

  LOG_WRN("WASM execution error recorded (total errors: %u)",
          g_wasm_metrics.error_count);
}

void task_monitor_wasm_oom(void)
{
  k_mutex_lock(&g_wasm_metrics_mutex, K_FOREVER);
  g_wasm_metrics.oom_count++;
  g_wasm_metrics.error_count++;
  k_mutex_unlock(&g_wasm_metrics_mutex);

  LOG_ERR("WASM OOM error recorded (total OOM: %u)", g_wasm_metrics.oom_count);
}

int task_monitor_get_wasm_metrics(wasm_metrics_t *metrics)
{
  if (metrics == NULL) {
    return -EINVAL;
  }

  k_mutex_lock(&g_wasm_metrics_mutex, K_FOREVER);
  memcpy(metrics, &g_wasm_metrics, sizeof(wasm_metrics_t));
  k_mutex_unlock(&g_wasm_metrics_mutex);

  return 0;
}

void task_monitor_reset_wasm_metrics(void)
{
  k_mutex_lock(&g_wasm_metrics_mutex, K_FOREVER);
  memset(&g_wasm_metrics, 0, sizeof(g_wasm_metrics));
  k_mutex_unlock(&g_wasm_metrics_mutex);

  LOG_INF("WASM metrics reset");
}
```

## src/task_monitor.h
```c
#ifndef TASK_MONITOR_H
#define TASK_MONITOR_H

#include <stdbool.h>
#include <stdint.h>

#ifdef __cplusplus
extern "C" {
#endif

#define MAX_MONITORED_TASKS 4
#define MAX_TASK_ID_LEN 64

/**
 * @brief WASM-specific execution metrics.
 */
typedef struct {
    uint32_t execution_count;       /**< Number of WASM executions completed */
    uint64_t total_execution_us;    /**< Total WASM execution time in microseconds */
    uint32_t error_count;           /**< Number of WASM execution errors */
    uint32_t oom_count;             /**< Number of out-of-memory errors */
    uint32_t last_execution_us;     /**< Duration of last WASM execution in microseconds */
    uint32_t max_execution_us;      /**< Maximum WASM execution time in microseconds */
} wasm_metrics_t;

/**
 * @brief Process-level metrics for a single sample.
 */
typedef struct {
    double cpu_percent;
    uint32_t memory_bytes;
    double memory_percent;
    int64_t uptime_seconds;
    uint32_t thread_count;
} process_metrics_t;

/**
 * @brief Aggregated metrics over multiple samples.
 */
typedef struct {
    double avg_cpu_usage;
    double max_cpu_usage;
    uint64_t avg_memory_usage;
    uint64_t max_memory_usage;
    int sample_count;
} aggregated_metrics_t;

/**
 * @brief Combined task metrics with current and aggregated data.
 */
typedef struct {
    char task_id[MAX_TASK_ID_LEN];
    bool active;
    int64_t start_time_ms;
    process_metrics_t current;
    aggregated_metrics_t aggregated;
} task_metrics_t;

/**
 * @brief Initialize the task monitor subsystem.
 *
 * Must be called before any other task_monitor functions.
 *
 * @return 0 on success, negative errno on failure.
 */
int task_monitor_init(void);

/**
 * @brief Start monitoring a task.
 *
 * Call this before WASM module execution begins.
 *
 * @param task_id Unique identifier for the task.
 * @return 0 on success, negative errno on failure.
 */
int task_monitor_start(const char *task_id);

/**
 * @brief Record a metrics sample for a task.
 *
 * Call this periodically or after task execution to capture metrics.
 *
 * @param task_id Unique identifier for the task.
 * @return 0 on success, negative errno on failure.
 */
int task_monitor_sample(const char *task_id);

/**
 * @brief Stop monitoring a task.
 *
 * Call this after WASM execution completes or is stopped.
 *
 * @param task_id Unique identifier for the task.
 * @return 0 on success, negative errno on failure.
 */
int task_monitor_stop(const char *task_id);

/**
 * @brief Get metrics for a specific task.
 *
 * @param task_id Unique identifier for the task.
 * @param metrics Pointer to task_metrics_t to populate.
 * @return 0 on success, negative errno on failure.
 */
int task_monitor_get_metrics(const char *task_id, task_metrics_t *metrics);

/**
 * @brief Check if a task is currently being monitored.
 *
 * @param task_id Unique identifier for the task.
 * @return true if task is active, false otherwise.
 */
bool task_monitor_is_active(const char *task_id);

/**
 * @brief Get the ID of the first active monitored task.
 *
 * Useful for single-task scenarios common in embedded systems.
 *
 * @param task_id_out Buffer to store the task ID (must be at least MAX_TASK_ID_LEN).
 * @return 0 on success, -ENOENT if no active task.
 */
int task_monitor_get_active_task_id(char *task_id_out);

/**
 * @brief Get count of active monitored tasks.
 *
 * @return Number of currently monitored tasks.
 */
int task_monitor_get_active_count(void);

/**
 * @brief Get task ID for an active monitored task at index.
 *
 * Use with task_monitor_get_active_count() to iterate through all active tasks.
 *
 * @param index Index of the active task (0 to count-1).
 * @param task_id_out Buffer to store the task ID (must be at least MAX_TASK_ID_LEN).
 * @return 0 on success, -EINVAL if index is out of bounds or task_id_out is NULL.
 */
int task_monitor_get_active_task_id_at(int index, char *task_id_out);

/**
 * @brief Record a WASM execution start.
 *
 * Call this just before starting WASM execution to begin timing.
 *
 * @return Start timestamp in microseconds (for use with record_wasm_execution_end).
 */
uint64_t task_monitor_wasm_start(void);

/**
 * @brief Record a successful WASM execution completion.
 *
 * @param start_us Start timestamp from task_monitor_wasm_start().
 */
void task_monitor_wasm_end(uint64_t start_us);

/**
 * @brief Record a WASM execution error.
 */
void task_monitor_wasm_error(void);

/**
 * @brief Record an out-of-memory error during WASM execution.
 */
void task_monitor_wasm_oom(void);

/**
 * @brief Get global WASM execution metrics.
 *
 * @param metrics Pointer to wasm_metrics_t to populate.
 * @return 0 on success, negative errno on failure.
 */
int task_monitor_get_wasm_metrics(wasm_metrics_t *metrics);

/**
 * @brief Reset WASM execution metrics.
 */
void task_monitor_reset_wasm_metrics(void);

#ifdef __cplusplus
}
#endif

#endif /* TASK_MONITOR_H */
```

## src/wasm_handler.h
```c
#ifndef WASM_HANDLER_H
#define WASM_HANDLER_H

#include <stddef.h>
#include <stdint.h>

#ifdef __cplusplus
extern "C"
{
#endif

    /**
     * Loads and instantiates a Wasm module, then invokes its "main" function (if
     * present). The module remains loaded in memory so that it can be stopped later
     * by ID.
     *
     * @param task_id     Unique identifier (string) for this Wasm "task."
     * @param wasm_data   Pointer to the Wasm file data in memory.
     * @param wasm_size   Size of the Wasm file data in bytes.
     * @param inputs      Array of 64-bit inputs that the Wasm main function might
     * consume.
     * @param inputs_count Number of elements in the 'inputs' array.
     */
    void execute_wasm_module(const char *task_id, const uint8_t *wasm_data,
                             size_t wasm_size, const uint64_t *inputs,
                             size_t inputs_count);

    /**
     * Stops the Wasm module with the given task_id by deinstantiating and unloading
     * it from memory.
     *
     * @param task_id  The unique string ID assigned to the Wasm module at start
     * time.
     */
    void stop_wasm_app(const char *task_id);

#ifdef __cplusplus
}
#endif

#endif /* WASM_HANDLER_H */
```
