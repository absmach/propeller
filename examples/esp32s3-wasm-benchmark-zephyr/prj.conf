## CMakeLists.txt
```
cmake_minimum_required(VERSION 3.20.0)

set(BOARD esp32s3_devkitc)

find_package(Zephyr REQUIRED HINTS $ENV{ZEPHYR_BASE})
project(esp32s3_wasm_benchmark_zephyr)

set(WAMR_BUILD_PLATFORM "zephyr")
set(WAMR_BUILD_TARGET "XTENSA")

if (NOT DEFINED WAMR_BUILD_INTERP)
  set(WAMR_BUILD_INTERP 1)
endif ()

if (NOT DEFINED WAMR_BUILD_AOT)
  set(WAMR_BUILD_AOT 1)
endif ()

if (NOT DEFINED WAMR_BUILD_LIBC_BUILTIN)
  set(WAMR_BUILD_LIBC_BUILTIN 1)
endif ()

if (NOT DEFINED WAMR_BUILD_LIBC_WASI)
  set(WAMR_BUILD_LIBC_WASI 0)
endif ()

# Use system allocator (malloc/free) so all allocations show in heap stats.
set(WAMR_BUILD_GLOBAL_HEAP_POOL 0)

set(WAMR_ROOT_DIR ${CMAKE_CURRENT_SOURCE_DIR}/../../embed-proplet/modules/wamr/wasm-micro-runtime)
include(${WAMR_ROOT_DIR}/build-scripts/runtime_lib.cmake)

list(APPEND ZEPHYR_EXTRA_MODULES ${WAMR_ROOT_DIR}/product-mini/platforms/zephyr)

include_directories(${ZEPHYR_BASE}/include/zephyr)

target_include_directories(app PRIVATE
    ${WAMR_ROOT_DIR}/core/iwasm/include
    src
)

zephyr_library_named(wamr_lib)
zephyr_library_sources(${WAMR_RUNTIME_LIB_SOURCE})
zephyr_library_app_memory(wamr_partition)

target_sources(app PRIVATE
    src/main.c
    src/bench.c
    src/metrics.c
)

target_link_libraries(app PRIVATE wamr_lib)
```

## prj.conf
```kconfig
# Logging
CONFIG_LOG=y
CONFIG_LOG_DEFAULT_LEVEL=3
CONFIG_LOG_MODE_IMMEDIATE=y
CONFIG_EARLY_CONSOLE=y

# Main thread stack — needs room for WAMR init + printf buffers
CONFIG_MAIN_STACK_SIZE=16384

# Thread support
CONFIG_THREAD_MONITOR=y
CONFIG_THREAD_NAME=y

# CPU usage tracking (used by metrics.c)
CONFIG_THREAD_RUNTIME_STATS=y

# Use minimal libc so malloc is backed by z_malloc_heap
# (enables heap stats via sys_heap_runtime_stats_get + CONFIG_SYS_HEAP_RUNTIME_STATS).
# ARENA_SIZE must be non-zero or malloc always returns NULL.
CONFIG_MINIMAL_LIBC=y
CONFIG_COMMON_LIBC_MALLOC_ARENA_SIZE=196608

# Heap runtime stats (used by metrics.c to report free/watermark bytes)
CONFIG_SYS_HEAP_RUNTIME_STATS=y

# Stack safety
CONFIG_STACK_SENTINEL=y
CONFIG_INIT_STACKS=y

# Needed by WAMR
CONFIG_BASE64=y
CONFIG_FPU=y

# Disable WiFi and networking (not needed for benchmark)
CONFIG_WIFI=n
CONFIG_NETWORKING=n
```

## boards/esp32s3_devkitc_procpu.conf
```kconfig
# Disable WiFi driver — not needed for benchmark
CONFIG_WIFI_ESP32=n
```

## src/main.c
```c
#include <stdio.h>
#include <string.h>
#include <stdlib.h>

#include <zephyr/kernel.h>
#include <zephyr/logging/log.h>
#include "wasm_export.h"

#include "bench.h"
#include "metrics.h"

LOG_MODULE_REGISTER(main);

#define EXPERIMENT 0

#define WASM_STACK_KB  4
#define WASM_HEAP_KB   8

static void wamr_global_init(void)
{
    RuntimeInitArgs init_args;

    memset(&init_args, 0, sizeof(init_args));

    init_args.mem_alloc_type = Alloc_With_Allocator;
    init_args.mem_alloc_option.allocator.malloc_func  = (void *)malloc;
    init_args.mem_alloc_option.allocator.realloc_func = (void *)realloc;
    init_args.mem_alloc_option.allocator.free_func    = (void *)free;

    if (!wasm_runtime_full_init(&init_args)) {
        LOG_ERR("WAMR global init failed – halting");
        while (1) {
            k_sleep(K_FOREVER);
        }
    }
    LOG_INF("WAMR initialised");
}

static void print_system_info(void)
{
    metrics_t m;

    metrics_sample(&m);

    printf("\n========================================\n");
    printf("  ESP32-S3 WASM Benchmark (Zephyr)\n");
    printf("========================================\n");
    printf("Malloc arena   : %u KB  (CONFIG_COMMON_LIBC_MALLOC_ARENA_SIZE)\n",
           (unsigned)(CONFIG_COMMON_LIBC_MALLOC_ARENA_SIZE / 1024));
    printf("Heap free now  : %u KB\n", (unsigned)(m.heap_free / 1024));
    printf("Thread stacks  : %d slots × 4 KB = %u KB (static, not in arena)\n",
           24, (unsigned)(24 * 4));
    printf("Uptime         : %u ms\n", (unsigned)m.uptime_ms);
    printf("========================================\n\n");
}

int main(void)
{
    k_sleep(K_MSEC(1000));

    wamr_global_init();
    print_system_info();

    bench_config_t cfg;

    bench_config_default(&cfg);
    cfg.wasm_stack_kb    = WASM_STACK_KB;
    cfg.wasm_heap_kb     = WASM_HEAP_KB;
    cfg.scale_delay_ms   = 300;
    cfg.measure_delay_ms = 2000;

#if EXPERIMENT == 0
    bench_run_all_workloads(&cfg);

#elif EXPERIMENT == 1
    cfg.workload = WORKLOAD_CPU;
    bench_run(&cfg);

#elif EXPERIMENT == 2
    cfg.workload = WORKLOAD_MEM;
    bench_run(&cfg);

#elif EXPERIMENT == 3
    cfg.workload = WORKLOAD_MSG;
    bench_run(&cfg);

#elif EXPERIMENT == 4
    printf("\n--- Experiment: Core Pinning ---\n");
    printf("Run 1: All instances on Core 0\n");
    cfg.workload      = WORKLOAD_CPU;
    cfg.core_affinity = 0;
    int core0_max = bench_run(&cfg);
    k_sleep(K_MSEC(2000));

    printf("\nRun 2: All instances on Core 1\n");
    cfg.core_affinity = 1;
    int core1_max = bench_run(&cfg);
    k_sleep(K_MSEC(2000));

    printf("\nRun 3: Distributed (no affinity)\n");
    cfg.core_affinity = -1;
    int dist_max = bench_run(&cfg);

    printf("\n╔══════════════════════════════╗\n");
    printf("║  Pinning Summary             ║\n");
    printf("╠══════════════════════════════╣\n");
    printf("║  Core 0 only  : %-3d instances║\n", core0_max);
    printf("║  Core 1 only  : %-3d instances║\n", core1_max);
    printf("║  Distributed  : %-3d instances║\n", dist_max);
    printf("╚══════════════════════════════╝\n");

#elif EXPERIMENT == 5
    bench_compare_modes(&cfg);

#elif EXPERIMENT == 6
    bench_run_diverse(&cfg);
#endif

    printf("\nBenchmark complete. Halting.\n");
    wasm_runtime_destroy();

    while (1) {
        k_sleep(K_MSEC(5000));
        metrics_t m;

        metrics_sample(&m);
        printf("[idle] heap=%uKB  cpu=%u%%\n",
               (unsigned)(m.heap_free / 1024), (unsigned)m.cpu_percent);
    }

    return 0;
}
```

## src/bench.c
```c
#include "bench.h"
#include "metrics.h"
#include "wasm_bins.h"
#include "wasm_tasks.h"

#include <stdio.h>
#include <string.h>
#include <stdlib.h>

#include <zephyr/kernel.h>
#include <zephyr/logging/log.h>
#include "wasm_export.h"

LOG_MODULE_REGISTER(bench);

#define MAX_INSTANCES    24
#define ERROR_BUF_SIZE   128

#define BENCH_THREAD_STACK_SIZE (4 * 1024)

K_THREAD_STACK_ARRAY_DEFINE(s_stacks, MAX_INSTANCES, BENCH_THREAD_STACK_SIZE);

static wasm_module_t    s_shared_module  = NULL;
static bench_instance_t s_instances[MAX_INSTANCES];
static int              s_instance_count = 0;

static const uint8_t *workload_bytes(workload_type_t w, uint32_t *len)
{
    switch (w) {
    case WORKLOAD_CPU: *len = wasm_cpu_stress_len; return wasm_cpu_stress;
    case WORKLOAD_MEM: *len = wasm_mem_stress_len; return wasm_mem_stress;
    case WORKLOAD_MSG: *len = wasm_msg_stress_len; return wasm_msg_stress;
    default:           *len = 0;                   return NULL;
    }
}

static const char *workload_name(workload_type_t w)
{
    switch (w) {
    case WORKLOAD_CPU: return "cpu";
    case WORKLOAD_MEM: return "mem";
    case WORKLOAD_MSG: return "msg";
    default:           return "???";
    }
}

static void wasm_worker_entry(void *p1, void *p2, void *p3)
{
    bench_instance_t *inst = (bench_instance_t *)p1;
    char err[ERROR_BUF_SIZE];

    ARG_UNUSED(p2);
    ARG_UNUSED(p3);

    inst->module_inst = wasm_runtime_instantiate(
        (wasm_module_t)inst->parent_module,
        inst->wasm_stack_bytes,
        0,
        err, sizeof(err));

    if (!inst->module_inst) {
        LOG_WRN("[%d] instantiate failed: %s", inst->id, err);
        inst->errors++;
        inst->alive = false;
        return;
    }

    inst->exec_env = wasm_runtime_create_exec_env(
        (wasm_module_inst_t)inst->module_inst,
        inst->wasm_stack_bytes);

    if (!inst->exec_env) {
        LOG_WRN("[%d] create_exec_env failed", inst->id);
        inst->errors++;
        wasm_runtime_deinstantiate((wasm_module_inst_t)inst->module_inst);
        inst->module_inst = NULL;
        inst->alive = false;
        return;
    }

    wasm_function_inst_t main_fn =
        wasm_runtime_lookup_function((wasm_module_inst_t)inst->module_inst, "main");
    if (!main_fn) {
        main_fn = wasm_runtime_lookup_function(
            (wasm_module_inst_t)inst->module_inst, "_start");
    }

    if (!main_fn) {
        LOG_WRN("[%d] no main/_start export", inst->id);
        inst->errors++;
        goto done;
    }

    while (inst->running) {
        uint64_t t0 = k_cyc_to_us_floor64(k_cycle_get_64());

        uint32_t argv[2] = {0, 0};
        bool ok = wasm_runtime_call_wasm(
            (wasm_exec_env_t)inst->exec_env, main_fn, 2, argv);

        inst->last_latency_us = (uint32_t)(
            k_cyc_to_us_floor64(k_cycle_get_64()) - t0);

        if (!ok) {
            const char *ex = wasm_runtime_get_exception(
                (wasm_module_inst_t)inst->module_inst);
            LOG_WRN("[%d] exception: %s", inst->id, ex ? ex : "?");
            wasm_runtime_clear_exception(
                (wasm_module_inst_t)inst->module_inst);
            inst->errors++;
        } else {
            inst->iterations++;
        }

        k_sleep(K_MSEC(5));
    }

done:
    wasm_runtime_destroy_exec_env((wasm_exec_env_t)inst->exec_env);
    wasm_runtime_deinstantiate((wasm_module_inst_t)inst->module_inst);
    inst->exec_env    = NULL;
    inst->module_inst = NULL;
    inst->alive       = false;
}

static bool spawn_instance(int idx, const bench_config_t *cfg,
                           void *module, const char *name)
{
    if (idx >= MAX_INSTANCES) {
        LOG_WRN("instance index %d >= MAX_INSTANCES %d", idx, MAX_INSTANCES);
        return false;
    }

    bench_instance_t *inst = &s_instances[idx];
    memset(inst, 0, sizeof(*inst));

    inst->id               = idx;
    inst->workload         = cfg->workload;
    inst->running          = true;
    inst->alive            = true;
    inst->wasm_stack_bytes = cfg->wasm_stack_kb * 1024;
    inst->parent_module    = module ? module : (void *)s_shared_module;
    inst->task_name        = name;

    inst->tid = k_thread_create(
        &inst->thread_data,
        s_stacks[idx],
        BENCH_THREAD_STACK_SIZE,
        wasm_worker_entry,
        inst, NULL, NULL,
        K_LOWEST_APPLICATION_THREAD_PRIO,
        0,
        K_NO_WAIT);

    if (!inst->tid) {
        LOG_WRN("[%d] k_thread_create failed", idx);
        inst->alive = false;
        return false;
    }

#ifdef CONFIG_SCHED_CPU_MASK
    if (cfg->core_affinity >= 0) {
        k_thread_cpu_pin(inst->tid, cfg->core_affinity);
    }
#endif

    return true;
}

static void stop_all_instances(void)
{
    for (int i = 0; i < s_instance_count; i++) {
        s_instances[i].running = false;
    }
    for (int i = 0; i < s_instance_count; i++) {
        if (s_instances[i].tid) {
            k_thread_join(s_instances[i].tid, K_FOREVER);
            s_instances[i].tid = NULL;
        }
    }
    s_instance_count = 0;
}

static void print_instance_stats(void)
{
    printf("\n--- Instance detail ---\n");
    printf("  id  task        iters     errors  latency_us\n");
    for (int i = 0; i < s_instance_count; i++) {
        bench_instance_t *inst = &s_instances[i];
        const char *label = inst->task_name ? inst->task_name
                                             : workload_name(inst->workload);
        printf("  %-3d %-10s  %-8u  %-6u  %u\n",
               inst->id,
               label,
               (unsigned)inst->iterations,
               (unsigned)inst->errors,
               (unsigned)inst->last_latency_us);
    }
    printf("---\n\n");
}

void bench_config_default(bench_config_t *cfg)
{
    cfg->mode             = MODE_SHARED_MODULE;
    cfg->workload         = WORKLOAD_CPU;
    cfg->wasm_stack_kb    = 4;
    cfg->wasm_heap_kb     = 8;
    cfg->task_stack_kb    = 6;
    cfg->core_affinity    = -1;
    cfg->scale_delay_ms   = 500;
    cfg->measure_delay_ms = 2000;
    cfg->max_instances    = MAX_INSTANCES;
}

int bench_run(const bench_config_t *cfg)
{
    int peak_instances = 0;

    printf("\n=== WASM Stress Benchmark (Zephyr) ===\n");
    printf("workload=%s  wasm_stack=%uKB\n",
           workload_name(cfg->workload), (unsigned)cfg->wasm_stack_kb);
    printf("thread_stack=%uKB (pre-allocated, %d slots)  core=%d\n\n",
           (unsigned)(BENCH_THREAD_STACK_SIZE / 1024), MAX_INSTANCES,
           cfg->core_affinity);

    uint32_t wasm_len = 0;
    const uint8_t *wasm_ro = workload_bytes(cfg->workload, &wasm_len);

    if (!wasm_ro || wasm_len == 0) {
        LOG_ERR("No WASM bytes for workload %d", cfg->workload);
        return 0;
    }

    uint8_t *wasm_bytes = malloc(wasm_len);

    if (!wasm_bytes) {
        LOG_ERR("malloc(%u) for WASM buffer failed", (unsigned)wasm_len);
        return 0;
    }
    memcpy(wasm_bytes, wasm_ro, wasm_len);

    char err[ERROR_BUF_SIZE];

    s_shared_module = wasm_runtime_load(wasm_bytes, wasm_len, err, sizeof(err));

    if (!s_shared_module) {
        LOG_ERR("wasm_runtime_load failed: %s", err);
        free(wasm_bytes);
        return 0;
    }

    s_instance_count = 0;
    metrics_init();

    for (int n = 1; n <= cfg->max_instances; n++) {
        metrics_t m_before;

        metrics_sample(&m_before);

        if (!spawn_instance(s_instance_count, cfg,
                            (void *)s_shared_module,
                            workload_name(cfg->workload))) {
            printf("instances=%-3d  SPAWN_FAIL\n", n);
            break;
        }
        s_instance_count++;
        peak_instances = s_instance_count;

        k_sleep(K_MSEC(cfg->scale_delay_ms));

        if (!s_instances[s_instance_count - 1].alive) {
            printf("instances=%-3d  TASK_DIED (errors=%u)\n",
                   n, (unsigned)s_instances[s_instance_count - 1].errors);
            s_instance_count--;
            peak_instances = s_instance_count;
            break;
        }

        k_sleep(K_MSEC(cfg->measure_delay_ms));

        metrics_t m;

        metrics_sample(&m);
        metrics_print(s_instance_count, &m);

        uint32_t delta = (m_before.heap_free > m.heap_free) ?
                         (m_before.heap_free - m.heap_free) : 0;
        printf("  +instance cost ~%uKB  latency %uus\n",
               (unsigned)(delta / 1024),
               (unsigned)s_instances[s_instance_count - 1].last_latency_us);
    }

    k_sleep(K_MSEC(cfg->measure_delay_ms));
    printf("\n--- Peak: %d concurrent WASM instances ---\n", peak_instances);
    print_instance_stats();

    stop_all_instances();
    wasm_runtime_unload(s_shared_module);
    s_shared_module = NULL;

    metrics_t m_final;

    metrics_sample(&m_final);
    printf("Post-teardown heap: %uKB free\n\n",
           (unsigned)(m_final.heap_free / 1024));

    return peak_instances;
}

void bench_run_all_workloads(const bench_config_t *base_cfg)
{
    int results[WORKLOAD_COUNT];
    bench_config_t cfg;

    printf("\n╔══════════════════════════════════════════╗\n");
    printf("║  WORKLOAD COMPARISON                     ║\n");
    printf("╚══════════════════════════════════════════╝\n\n");

    for (int w = 0; w < WORKLOAD_COUNT; w++) {
        memcpy(&cfg, base_cfg, sizeof(cfg));
        cfg.workload = (workload_type_t)w;
        results[w] = bench_run(&cfg);
        k_sleep(K_MSEC(2000));
    }

    printf("\n╔══════════════════════════════════════════╗\n");
    printf("║  SUMMARY                                 ║\n");
    printf("╠══════════════════════════════════════════╣\n");
    for (int w = 0; w < WORKLOAD_COUNT; w++) {
        printf("║  %-8s  max_instances = %-3d           ║\n",
               workload_name((workload_type_t)w), results[w]);
    }
    printf("╚══════════════════════════════════════════╝\n\n");
}

void bench_compare_modes(const bench_config_t *base_cfg)
{
    bench_config_t cfg;

    printf("\n╔══════════════════════════════════════════╗\n");
    printf("║  MODE COMPARISON (workload: cpu)         ║\n");
    printf("╚══════════════════════════════════════════╝\n\n");

    memcpy(&cfg, base_cfg, sizeof(cfg));
    cfg.mode = MODE_SHARED_MODULE;
    int shared = bench_run(&cfg);

    printf("Shared module: %d instances\n", shared);
}

#define DIVERSE_TASK_COUNT 5

static const struct {
    const char    *name;
    const uint8_t *bytes_ro;
    uint32_t       len;
} s_task_defs[DIVERSE_TASK_COUNT] = {
    { "add",      wasm_add,      wasm_add_len      },
    { "mul",      wasm_mul,      wasm_mul_len      },
    { "fib",      wasm_fib,      wasm_fib_len      },
    { "checksum", wasm_checksum, wasm_checksum_len },
    { "popcount", wasm_popcount, wasm_popcount_len },
};

void bench_run_diverse(const bench_config_t *cfg)
{
    wasm_module_t modules[DIVERSE_TASK_COUNT];
    uint8_t      *bufs[DIVERSE_TASK_COUNT];
    char          err[ERROR_BUF_SIZE];
    int           loaded = 0;

    memset(modules, 0, sizeof(modules));
    memset(bufs,    0, sizeof(bufs));

    printf("\n╔══════════════════════════════════════════╗\n");
    printf("║  DIVERSE WORKLOAD BENCHMARK              ║\n");
    printf("║  5 tasks × N concurrent sets             ║\n");
    printf("╚══════════════════════════════════════════╝\n\n");
    printf("Tasks: add | mul | fib | checksum | popcount\n");
    printf("wasm_stack=%uKB  thread_stack=%uKB (pre-allocated)\n\n",
           (unsigned)cfg->wasm_stack_kb,
           (unsigned)(BENCH_THREAD_STACK_SIZE / 1024));

    for (int t = 0; t < DIVERSE_TASK_COUNT; t++) {
        bufs[t] = malloc(s_task_defs[t].len);
        if (!bufs[t]) {
            LOG_ERR("malloc failed for task %s", s_task_defs[t].name);
            goto cleanup;
        }
        memcpy(bufs[t], s_task_defs[t].bytes_ro, s_task_defs[t].len);

        modules[t] = wasm_runtime_load(bufs[t], s_task_defs[t].len,
                                       err, sizeof(err));
        if (!modules[t]) {
            LOG_ERR("wasm_runtime_load failed for %s: %s",
                    s_task_defs[t].name, err);
            free(bufs[t]);
            bufs[t] = NULL;
            goto cleanup;
        }
        bufs[t] = NULL;
        loaded = t + 1;
        LOG_INF("Loaded module: %s (%u bytes)",
                s_task_defs[t].name, (unsigned)s_task_defs[t].len);
    }

    s_instance_count = 0;
    metrics_init();

    int peak_sets = 0;
    int max_sets  = cfg->max_instances / DIVERSE_TASK_COUNT;

    for (int set_n = 1; set_n <= max_sets; set_n++) {
        bool ok = true;

        for (int t = 0; t < DIVERSE_TASK_COUNT && ok; t++) {
            if (!spawn_instance(s_instance_count, cfg,
                                (void *)modules[t], s_task_defs[t].name)) {
                printf("  SPAWN_FAIL  task=%s\n", s_task_defs[t].name);
                ok = false;
            } else {
                s_instance_count++;
            }
        }
        if (!ok) {
            break;
        }

        k_sleep(K_MSEC(cfg->scale_delay_ms));

        bool all_alive = true;

        for (int i = s_instance_count - DIVERSE_TASK_COUNT;
             i < s_instance_count; i++) {
            if (!s_instances[i].alive) {
                printf("  TASK_DIED  id=%d task=%s errors=%u\n",
                       s_instances[i].id,
                       s_instances[i].task_name,
                       (unsigned)s_instances[i].errors);
                all_alive = false;
            }
        }
        if (!all_alive) {
            s_instance_count -= DIVERSE_TASK_COUNT;
            break;
        }

        k_sleep(K_MSEC(cfg->measure_delay_ms));

        metrics_t m;

        metrics_sample(&m);
        printf("set_size=%-2d  total=%-3d  heap=%4uKB  cpu=%3u%%  up=%us\n",
               set_n, s_instance_count,
               (unsigned)(m.heap_free / 1024),
               (unsigned)m.cpu_percent,
               (unsigned)(m.uptime_ms / 1000));

        for (int t = 0; t < DIVERSE_TASK_COUNT; t++) {
            uint64_t lat_sum  = 0;
            uint32_t iter_sum = 0;
            uint32_t err_sum  = 0;
            int      count    = 0;

            for (int i = t; i < s_instance_count; i += DIVERSE_TASK_COUNT) {
                lat_sum  += s_instances[i].last_latency_us;
                iter_sum += s_instances[i].iterations;
                err_sum  += s_instances[i].errors;
                count++;
            }
            printf("  %-10s  latency=%6uus  iters=%-6u  errors=%u\n",
                   s_task_defs[t].name,
                   count ? (unsigned)(lat_sum / count) : 0,
                   (unsigned)iter_sum,
                   (unsigned)err_sum);
        }
        peak_sets = set_n;
    }

    k_sleep(K_MSEC(cfg->measure_delay_ms));
    printf("\n--- Peak: %d sets  (%d total WASM instances) ---\n",
           peak_sets, peak_sets * DIVERSE_TASK_COUNT);
    print_instance_stats();

    stop_all_instances();

    metrics_t m_final;

    metrics_sample(&m_final);
    printf("Post-teardown heap: %uKB free\n\n",
           (unsigned)(m_final.heap_free / 1024));

cleanup:
    for (int t = 0; t < loaded; t++) {
        if (modules[t]) {
            wasm_runtime_unload(modules[t]);
        }
    }
    for (int t = 0; t < DIVERSE_TASK_COUNT; t++) {
        if (bufs[t]) {
            free(bufs[t]);
        }
    }
}
```

## src/bench.h
```c
#pragma once

#include <stdbool.h>
#include <stdint.h>
#include <zephyr/kernel.h>

typedef enum {
    WORKLOAD_CPU = 0,
    WORKLOAD_MEM,
    WORKLOAD_MSG,
    WORKLOAD_COUNT
} workload_type_t;

typedef struct {
    int              id;
    workload_type_t  workload;
    volatile bool    running;
    volatile bool    alive;
    uint32_t         iterations;
    uint32_t         errors;
    uint32_t         last_latency_us;
    uint32_t         wasm_stack_bytes;

    struct k_thread  thread_data;
    k_tid_t          tid;

    void            *parent_module;
    const char      *task_name;

    void            *module_inst;
    void            *exec_env;
} bench_instance_t;

typedef enum {
    MODE_SHARED_MODULE = 0,
} bench_mode_t;

typedef struct {
    bench_mode_t     mode;
    workload_type_t  workload;
    uint32_t         wasm_stack_kb;
    uint32_t         wasm_heap_kb;
    uint32_t         task_stack_kb;
    int              core_affinity;
    uint32_t         scale_delay_ms;
    uint32_t         measure_delay_ms;
    int              max_instances;
} bench_config_t;

void bench_config_default(bench_config_t *cfg);
int  bench_run(const bench_config_t *cfg);
void bench_run_all_workloads(const bench_config_t *base_cfg);
void bench_compare_modes(const bench_config_t *base_cfg);
void bench_run_diverse(const bench_config_t *cfg);
```

## src/metrics.c
```c
#include "metrics.h"

#include <stdio.h>
#include <string.h>

#include <zephyr/kernel.h>
#include <zephyr/logging/log.h>
#include <zephyr/sys/mem_stats.h>

LOG_MODULE_REGISTER(metrics);

int malloc_runtime_stats_get(struct sys_memory_stats *stats);

static uint32_t heap_free_bytes(void)
{
    struct sys_memory_stats stats;

    if (malloc_runtime_stats_get(&stats) == 0) {
        return (uint32_t)stats.free_bytes;
    }
    return 0;
}

static uint32_t heap_min_free_bytes(void)
{
    struct sys_memory_stats stats;

    if (malloc_runtime_stats_get(&stats) == 0) {
        size_t total = stats.free_bytes + stats.allocated_bytes;

        if (stats.max_allocated_bytes <= total) {
            return (uint32_t)(total - stats.max_allocated_bytes);
        }
    }
    return 0;
}

static uint64_t s_prev_exec_cycles;
static uint64_t s_prev_busy_cycles;

void metrics_init(void)
{
    k_thread_runtime_stats_t stats;

    k_thread_runtime_stats_all_get(&stats);
    s_prev_exec_cycles = stats.execution_cycles;
    s_prev_busy_cycles = stats.total_cycles;
}

void metrics_sample(metrics_t *out)
{
    out->heap_free = heap_free_bytes();
    out->heap_min  = heap_min_free_bytes();
    out->uptime_ms = (uint32_t)k_uptime_get();

    k_thread_runtime_stats_t stats;

    k_thread_runtime_stats_all_get(&stats);

    uint64_t exec_delta = stats.execution_cycles - s_prev_exec_cycles;
    uint64_t busy_delta = stats.total_cycles     - s_prev_busy_cycles;

    if (exec_delta > 0 && busy_delta <= exec_delta) {
        out->cpu_percent = (uint32_t)((busy_delta * 100ULL) / exec_delta);
    } else {
        out->cpu_percent = 0;
    }

    s_prev_exec_cycles = stats.execution_cycles;
    s_prev_busy_cycles = stats.total_cycles;
}

void metrics_print(int instances, const metrics_t *m)
{
    printf("instances=%-3d  heap=%4uKB  min=%4uKB  cpu=%3u%%  up=%us\n",
           instances,
           (unsigned)(m->heap_free / 1024),
           (unsigned)(m->heap_min  / 1024),
           (unsigned)m->cpu_percent,
           (unsigned)(m->uptime_ms / 1000));
}
```

## src/metrics.h
```c
#pragma once

#include <stdint.h>

typedef struct {
    uint32_t heap_free;
    uint32_t heap_min;
    uint32_t cpu_percent;
    uint32_t uptime_ms;
} metrics_t;

void metrics_init(void);
void metrics_sample(metrics_t *out);
void metrics_print(int instances, const metrics_t *m);
```

## src/wasm_bins.h
```c
#pragma once
#include <stdint.h>

static const uint8_t wasm_cpu_stress[] = {
    0x00, 0x61, 0x73, 0x6d, 0x01, 0x00, 0x00, 0x00, 0x01, 0x07, 0x01, 0x60, 0x02, 0x7f, 0x7f, 0x01,
    0x7f, 0x03, 0x02, 0x01, 0x00, 0x07, 0x08, 0x01, 0x04, 0x6d, 0x61, 0x69, 0x6e, 0x00, 0x00, 0x0a,
    0x39, 0x01, 0x37, 0x01, 0x02, 0x7f, 0x41, 0xc5, 0xbb, 0xf2, 0x88, 0x78, 0x21, 0x02, 0x41, 0x00,
    0x21, 0x03, 0x02, 0x40, 0x03, 0x40, 0x20, 0x03, 0x41, 0x90, 0xce, 0x00, 0x4e, 0x0d, 0x01, 0x20,
    0x02, 0x20, 0x03, 0x73, 0x41, 0x93, 0x83, 0x80, 0x08, 0x6c, 0x21, 0x02, 0x20, 0x03, 0x41, 0x01,
    0x6a, 0x21, 0x03, 0x0c, 0x00, 0x0b, 0x0b, 0x41, 0x00, 0x0b,
};
static const uint32_t wasm_cpu_stress_len = sizeof(wasm_cpu_stress);

static const uint8_t wasm_mem_stress[] = {
    0x00, 0x61, 0x73, 0x6d, 0x01, 0x00, 0x00, 0x00, 0x01, 0x07, 0x01, 0x60, 0x02, 0x7f, 0x7f, 0x01,
    0x7f, 0x03, 0x02, 0x01, 0x00, 0x05, 0x03, 0x01, 0x00, 0x01, 0x07, 0x08, 0x01, 0x04, 0x6d, 0x61,
    0x69, 0x6e, 0x00, 0x00, 0x0a, 0x6b, 0x01, 0x69, 0x01, 0x03, 0x7f, 0x41, 0x00, 0x21, 0x02, 0x02,
    0x40, 0x03, 0x40, 0x20, 0x02, 0x41, 0xe4, 0x00, 0x4e, 0x0d, 0x01, 0x41, 0x00, 0x21, 0x03, 0x02,
    0x40, 0x03, 0x40, 0x20, 0x03, 0x41, 0x80, 0x08, 0x4e, 0x0d, 0x01, 0x20, 0x03, 0x20, 0x03, 0x41,
    0xff, 0x01, 0x71, 0x3a, 0x00, 0x00, 0x20, 0x03, 0x41, 0x01, 0x6a, 0x21, 0x03, 0x0c, 0x00, 0x0b,
    0x0b, 0x41, 0x00, 0x21, 0x03, 0x02, 0x40, 0x03, 0x40, 0x20, 0x03, 0x41, 0x80, 0x08, 0x4e, 0x0d,
    0x01, 0x20, 0x03, 0x2d, 0x00, 0x00, 0x21, 0x04, 0x20, 0x03, 0x41, 0x01, 0x6a, 0x21, 0x03, 0x0c,
    0x00, 0x0b, 0x0b, 0x20, 0x02, 0x41, 0x01, 0x6a, 0x21, 0x02, 0x0c, 0x00, 0x0b, 0x0b, 0x41, 0x00,
    0x0b,
};
static const uint32_t wasm_mem_stress_len = sizeof(wasm_mem_stress);

static const uint8_t wasm_msg_stress[] = {
    0x00, 0x61, 0x73, 0x6d, 0x01, 0x00, 0x00, 0x00, 0x01, 0x07, 0x01, 0x60, 0x02, 0x7f, 0x7f, 0x01,
    0x7f, 0x03, 0x02, 0x01, 0x00, 0x05, 0x03, 0x01, 0x00, 0x01, 0x07, 0x08, 0x01, 0x04, 0x6d, 0x61,
    0x69, 0x6e, 0x00, 0x00, 0x0a, 0x83, 0x01, 0x01, 0x80, 0x01, 0x01, 0x01, 0x7f, 0x41, 0x80, 0x08,
    0x41, 0x00, 0x36, 0x02, 0x00, 0x41, 0x84, 0x08, 0x41, 0x00, 0x36, 0x02, 0x00, 0x41, 0x00, 0x21,
    0x02, 0x02, 0x40, 0x03, 0x40, 0x20, 0x02, 0x41, 0xe8, 0x07, 0x4e, 0x0d, 0x01, 0x41, 0x84, 0x08,
    0x28, 0x02, 0x00, 0x41, 0xff, 0x01, 0x71, 0x41, 0x02, 0x74, 0x20, 0x02, 0x41, 0xed, 0x9c, 0x99,
    0x8e, 0x04, 0x6c, 0x41, 0xb9, 0xe0, 0x00, 0x6a, 0x36, 0x02, 0x00, 0x41, 0x84, 0x08, 0x41, 0x84,
    0x08, 0x28, 0x02, 0x00, 0x41, 0x01, 0x6a, 0x36, 0x02, 0x00, 0x41, 0x84, 0x08, 0x28, 0x02, 0x00,
    0x41, 0x80, 0x08, 0x28, 0x02, 0x00, 0x6b, 0x41, 0x40, 0x49, 0x04, 0x40, 0x41, 0x80, 0x08, 0x41,
    0x80, 0x08, 0x28, 0x02, 0x00, 0x41, 0x01, 0x6a, 0x36, 0x02, 0x00, 0x0b, 0x20, 0x02, 0x41, 0x01,
    0x6a, 0x21, 0x02, 0x0c, 0x00, 0x0b, 0x0b, 0x41, 0x00, 0x0b,
};
static const uint32_t wasm_msg_stress_len = sizeof(wasm_msg_stress);
```

## src/wasm_tasks.h
```c
#pragma once
#include <stdint.h>

static const uint8_t wasm_add[] = {
    0x00, 0x61, 0x73, 0x6d, 0x01, 0x00, 0x00, 0x00, 0x01, 0x07, 0x01, 0x60, 0x02, 0x7f, 0x7f, 0x01,
    0x7f, 0x03, 0x02, 0x01, 0x00, 0x07, 0x08, 0x01, 0x04, 0x6d, 0x61, 0x69, 0x6e, 0x00, 0x00, 0x0a,
    0x27, 0x01, 0x25, 0x01, 0x02, 0x7f, 0x02, 0x40, 0x03, 0x40, 0x20, 0x03, 0x41, 0xd0, 0x86, 0x03,
    0x4f, 0x0d, 0x01, 0x20, 0x02, 0x20, 0x03, 0x6a, 0x21, 0x02, 0x20, 0x03, 0x41, 0x01, 0x6a, 0x21,
    0x03, 0x0c, 0x00, 0x0b, 0x0b, 0x41, 0x00, 0x0b,
};
static const uint32_t wasm_add_len = sizeof(wasm_add);

static const uint8_t wasm_mul[] = {
    0x00, 0x61, 0x73, 0x6d, 0x01, 0x00, 0x00, 0x00, 0x01, 0x07, 0x01, 0x60, 0x02, 0x7f, 0x7f, 0x01,
    0x7f, 0x03, 0x02, 0x01, 0x00, 0x07, 0x08, 0x01, 0x04, 0x6d, 0x61, 0x69, 0x6e, 0x00, 0x00, 0x0a,
    0x2d, 0x01, 0x2b, 0x01, 0x02, 0x7f, 0x41, 0x01, 0x21, 0x02, 0x02, 0x40, 0x03, 0x40, 0x20, 0x03,
    0x41, 0xa0, 0x9c, 0x01, 0x4f, 0x0d, 0x01, 0x20, 0x02, 0x41, 0xc3, 0x84, 0x3d, 0x6c, 0x21, 0x02,
    0x20, 0x03, 0x41, 0x01, 0x6a, 0x21, 0x03, 0x0c, 0x00, 0x0b, 0x0b, 0x41, 0x00, 0x0b,
};
static const uint32_t wasm_mul_len = sizeof(wasm_mul);

static const uint8_t wasm_fib[] = {
    0x00, 0x61, 0x73, 0x6d, 0x01, 0x00, 0x00, 0x00, 0x01, 0x07, 0x01, 0x60, 0x02, 0x7f, 0x7f, 0x01,
    0x7f, 0x03, 0x02, 0x01, 0x00, 0x07, 0x08, 0x01, 0x04, 0x6d, 0x61, 0x69, 0x6e, 0x00, 0x00, 0x0a,
    0x50, 0x01, 0x4e, 0x01, 0x05, 0x7f, 0x02, 0x40, 0x03, 0x40, 0x20, 0x02, 0x41, 0xf4, 0x03, 0x4f,
    0x0d, 0x01, 0x41, 0x00, 0x21, 0x03, 0x41, 0x01, 0x21, 0x04, 0x41, 0x00, 0x21, 0x06, 0x02, 0x40,
    0x03, 0x40, 0x20, 0x06, 0x41, 0x1e, 0x4f, 0x0d, 0x01, 0x20, 0x03, 0x20, 0x04, 0x6a, 0x21, 0x05,
    0x20, 0x04, 0x21, 0x03, 0x20, 0x05, 0x21, 0x04, 0x20, 0x06, 0x41, 0x01, 0x6a, 0x21, 0x06, 0x0c,
    0x00, 0x0b, 0x0b, 0x20, 0x02, 0x41, 0x01, 0x6a, 0x21, 0x02, 0x0c, 0x00, 0x0b, 0x0b, 0x41, 0x00,
    0x0b,
};
static const uint32_t wasm_fib_len = sizeof(wasm_fib);

static const uint8_t wasm_checksum[] = {
    0x00, 0x61, 0x73, 0x6d, 0x01, 0x00, 0x00, 0x00, 0x01, 0x07, 0x01, 0x60, 0x02, 0x7f, 0x7f, 0x01,
    0x7f, 0x03, 0x02, 0x01, 0x00, 0x05, 0x04, 0x01, 0x01, 0x01, 0x01, 0x07, 0x08, 0x01, 0x04, 0x6d,
    0x61, 0x69, 0x6e, 0x00, 0x00, 0x0a, 0x6a, 0x01, 0x68, 0x01, 0x03, 0x7f, 0x02, 0x40, 0x03, 0x40,
    0x20, 0x02, 0x41, 0xe4, 0x00, 0x4f, 0x0d, 0x01, 0x41, 0x00, 0x21, 0x03, 0x02, 0x40, 0x03, 0x40,
    0x20, 0x03, 0x41, 0x80, 0x20, 0x4f, 0x0d, 0x01, 0x20, 0x03, 0x20, 0x03, 0x41, 0xff, 0x01, 0x71,
    0x3a, 0x00, 0x00, 0x20, 0x03, 0x41, 0x01, 0x6a, 0x21, 0x03, 0x0c, 0x00, 0x0b, 0x0b, 0x41, 0x00,
    0x21, 0x03, 0x02, 0x40, 0x03, 0x40, 0x20, 0x03, 0x41, 0x80, 0x20, 0x4f, 0x0d, 0x01, 0x20, 0x04,
    0x20, 0x03, 0x2d, 0x00, 0x00, 0x73, 0x21, 0x04, 0x20, 0x03, 0x41, 0x01, 0x6a, 0x21, 0x03, 0x0c,
    0x00, 0x0b, 0x0b, 0x20, 0x02, 0x41, 0x01, 0x6a, 0x21, 0x02, 0x0c, 0x00, 0x0b, 0x0b, 0x41, 0x00,
    0x0b,
};
static const uint32_t wasm_checksum_len = sizeof(wasm_checksum);

static const uint8_t wasm_popcount[] = {
    0x00, 0x61, 0x73, 0x6d, 0x01, 0x00, 0x00, 0x00, 0x01, 0x07, 0x01, 0x60, 0x02, 0x7f, 0x7f, 0x01,
    0x7f, 0x03, 0x02, 0x01, 0x00, 0x07, 0x08, 0x01, 0x04, 0x6d, 0x61, 0x69, 0x6e, 0x00, 0x00, 0x0a,
    0x42, 0x01, 0x40, 0x01, 0x03, 0x7f, 0x02, 0x40, 0x03, 0x40, 0x20, 0x02, 0x41, 0xd0, 0x86, 0x03,
    0x4f, 0x0d, 0x01, 0x20, 0x02, 0x21, 0x04, 0x02, 0x40, 0x03, 0x40, 0x20, 0x04, 0x45, 0x0d, 0x01,
    0x20, 0x04, 0x20, 0x04, 0x41, 0x01, 0x6b, 0x71, 0x21, 0x04, 0x20, 0x03, 0x41, 0x01, 0x6a, 0x21,
    0x03, 0x0c, 0x00, 0x0b, 0x0b, 0x20, 0x02, 0x41, 0x01, 0x6a, 0x21, 0x02, 0x0c, 0x00, 0x0b, 0x0b,
    0x41, 0x00, 0x0b,
};
static const uint32_t wasm_popcount_len = sizeof(wasm_popcount);
```
