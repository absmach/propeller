## examples/esp32s3-wasm-benchmark-espidf/sdkconfig.defaults
```kconfig
# ESP32-S3 target
CONFIG_IDF_TARGET="esp32s3"

# ── CPU ──────────────────────────────────────────────────────────────────────
CONFIG_ESP_DEFAULT_CPU_FREQ_MHZ_240=y
CONFIG_ESP_DEFAULT_CPU_FREQ_MHZ=240

# ── Flash / Partitions ───────────────────────────────────────────────────────
CONFIG_ESPTOOLPY_FLASHSIZE_4MB=y
CONFIG_ESPTOOLPY_FLASHSIZE="4MB"
CONFIG_PARTITION_TABLE_CUSTOM=y
CONFIG_PARTITION_TABLE_CUSTOM_FILENAME="partitions.csv"

# ── PSRAM (optional – comment out if no PSRAM fitted) ────────────────────────
# CONFIG_ESP32S3_SPIRAM_SUPPORT=y
# CONFIG_SPIRAM_MODE_OCT=y
# CONFIG_SPIRAM_SPEED_80M=y
# CONFIG_SPIRAM_USE_CAPS_ALLOC=y

# ── Heap ─────────────────────────────────────────────────────────────────────
CONFIG_ESP_SYSTEM_ALLOW_RTC_FAST_MEM_AS_HEAP=y

# ── FreeRTOS runtime stats (for CPU% measurement) ────────────────────────────
CONFIG_FREERTOS_USE_TRACE_FACILITY=y
CONFIG_FREERTOS_GENERATE_RUN_TIME_STATS=y
CONFIG_FREERTOS_RUN_TIME_STATS_USING_ESP_TIMER=y
CONFIG_FREERTOS_USE_STATS_FORMATTING_FUNCTIONS=y

# ── Task watchdog ─────────────────────────────────────────────────────────────
CONFIG_ESP_TASK_WDT_EN=y
CONFIG_ESP_TASK_WDT_INIT=y
CONFIG_ESP_TASK_WDT_TIMEOUT_S=10
# Don't panic on WDT – we want to detect it and stop scaling
CONFIG_ESP_TASK_WDT_PANIC=n
# Stress benchmark intentionally pegs CPUs; don't alert on IDLE starvation
CONFIG_ESP_TASK_WDT_CHECK_IDLE_TASK_CPU0=n
CONFIG_ESP_TASK_WDT_CHECK_IDLE_TASK_CPU1=n

# ── Stack sizes ───────────────────────────────────────────────────────────────
CONFIG_ESP_MAIN_TASK_STACK_SIZE=8192

# ── Logging ───────────────────────────────────────────────────────────────────
CONFIG_LOG_DEFAULT_LEVEL_INFO=y
CONFIG_LOG_MAXIMUM_LEVEL_VERBOSE=y

# ── WAMR Kconfig options ─────────────────────────────────────────────────────
CONFIG_WAMR_ENABLE_INTERP=y
CONFIG_WAMR_INTERP_FAST=y
CONFIG_WAMR_ENABLE_AOT=n
CONFIG_WAMR_ENABLE_LIBC_BUILTIN=y
CONFIG_WAMR_ENABLE_LIBC_WASI=n
CONFIG_WAMR_ENABLE_LIB_PTHREAD=n
CONFIG_WAMR_ENABLE_MEMORY_PROFILING=n
CONFIG_WAMR_ENABLE_PERF_PROFILING=n
CONFIG_WAMR_ENABLE_MULTI_MODULE=n
CONFIG_WAMR_ENABLE_SHARED_MEMORY=n
CONFIG_WAMR_BUILD_RELEASE=y

# ── Disable memory protection (required for WAMR JIT/interp code exec) ───────
# CONFIG_ESP_SYSTEM_MEMPROT_FEATURE is not set
```
